#include "eink_warn.h"

#include <Arduino.h>
#include <string.h>

#include "epaper_config.h"
#include "port_display.h"

static const uint8_t FONT5X7[][5] = {
    {0x00, 0x00, 0x00, 0x00, 0x00},  // space
    {0x00, 0x00, 0x5F, 0x00, 0x00},  // !
    {0x00, 0x07, 0x00, 0x07, 0x00},  // "
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    {0x61, 0x51, 0x49, 0x45, 0x43},  // Z
};

static bool gReady = false;
static bool gDrawn = false;

// Lowercase glyphs so the notice can be drawn in the requested case.
static const uint8_t kLower[26][5] = {
    {0x20, 0x54, 0x54, 0x54, 0x78}, {0x7F, 0x48, 0x44, 0x44, 0x38},
    {0x38, 0x44, 0x44, 0x44, 0x20}, {0x38, 0x44, 0x44, 0x48, 0x7F},
    {0x38, 0x54, 0x54, 0x54, 0x18}, {0x08, 0x7E, 0x09, 0x01, 0x02},
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    {0x0C, 0x50, 0x50, 0x50, 0x3C}, {0x44, 0x64, 0x54, 0x4C, 0x44},
};

static const uint8_t *glyph(char c) {
  if (c >= 'a' && c <= 'z') {
    return kLower[c - 'a'];
  }
  if (c < ' ' || c > 'Z') {
    return FONT5X7[0];
  }
  return FONT5X7[c - ' '];
}

static void draw_char(int16_t x, int16_t y, char c, uint8_t scale) {
  const uint8_t *g = glyph(c);
  for (int col = 0; col < 5; ++col) {
    const uint8_t bits = g[col];
    for (int row = 0; row < 7; ++row) {
      if ((bits & (1 << row)) != 0) {
        EPD_FillRect(x + col * scale, y + row * scale, scale, scale, DRIVER_COLOR_BLACK);
      }
    }
  }
}

static void draw_text(int16_t x, int16_t y, const char *text, uint8_t scale) {
  while (*text != '\0') {
    draw_char(x, y, *text, scale);
    x = static_cast<int16_t>(x + 6 * scale);
    ++text;
  }
}

static void draw_warning(int16_t cx, int16_t top) {
  const int16_t tip_y = top;
  const int16_t base_y = static_cast<int16_t>(top + 70);
  const int16_t half = 40;
  EPD_DrawLine(cx, tip_y, cx - half, base_y, DRIVER_COLOR_BLACK);
  EPD_DrawLine(cx, tip_y, cx + half, base_y, DRIVER_COLOR_BLACK);
  EPD_DrawLine(cx - half, base_y, cx + half, base_y, DRIVER_COLOR_BLACK);
  EPD_FillRect(cx - 3, tip_y + 18, 6, 28, DRIVER_COLOR_BLACK);
  EPD_FillRect(cx - 3, tip_y + 52, 6, 6, DRIVER_COLOR_BLACK);
}

static void draw_centered(int16_t y, const char *text, uint8_t scale) {
  const int16_t width = static_cast<int16_t>(strlen(text) * 6 * scale);
  const int16_t x = static_cast<int16_t>((EPD_WIDTH - width) / 2);
  draw_text(x < 0 ? 0 : x, y, text, scale);
}

void eink_begin() {
  PortDisplay_Init();
  EPD_Init();
  gReady = true;
  eink_show();
}

void eink_show() {
  if (!gReady || gDrawn) {
    return;
  }
  gDrawn = true;

  EPD_Clear();
  draw_warning(100, 16);
  constexpr uint8_t kScale = 2;
  draw_centered(118, "Content on", kScale);
  draw_centered(142, "other display", kScale);
  EPD_Display();
}
