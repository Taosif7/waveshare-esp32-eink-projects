#include "eink_status.h"

#include <Arduino.h>
#include <assert.h>
#include <string.h>

#include <qrcodegen.h>

#include "epaper_config.h"
#include "exio/esp_io_expander_tca9554.h"
#include "port_display.h"
#include "port_i2c.h"

static const uint8_t FONT5X7[][5] = {
    {0x00, 0x00, 0x00, 0x00, 0x00},  // space
    {0x00, 0x00, 0x5F, 0x00, 0x00},  // !
    {0x00, 0x07, 0x00, 0x07, 0x00},  // "
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    {0x61, 0x51, 0x49, 0x45, 0x43},  // Z
};

static const uint8_t kLower[26][5] = {
    {0x20, 0x54, 0x54, 0x54, 0x78}, {0x7F, 0x48, 0x44, 0x44, 0x38},
    {0x38, 0x44, 0x44, 0x44, 0x20}, {0x38, 0x44, 0x44, 0x48, 0x7F},
    {0x38, 0x54, 0x54, 0x54, 0x18}, {0x08, 0x7E, 0x09, 0x01, 0x02},
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    {0x0C, 0x50, 0x50, 0x50, 0x3C}, {0x44, 0x64, 0x54, 0x4C, 0x44},
};

static I2cMasterBus *i2c_bus = nullptr;
static esp_io_expander_handle_t io_expander = nullptr;

static const uint8_t *glyph(char c) {
  if (c >= 'a' && c <= 'z') {
    return kLower[c - 'a'];
  }
  if (c < ' ' || c > 'Z') {
    return FONT5X7[0];
  }
  return FONT5X7[c - ' '];
}

static void draw_char(int16_t x, int16_t y, char c, uint8_t scale) {
  const uint8_t *g = glyph(c);
  for (int col = 0; col < 5; ++col) {
    const uint8_t bits = g[col];
    for (int row = 0; row < 7; ++row) {
      if ((bits & (1 << row)) != 0) {
        EPD_FillRect(x + col * scale, y + row * scale, scale, scale, DRIVER_COLOR_BLACK);
      }
    }
  }
}

static void draw_text(int16_t x, int16_t y, const char *text, uint8_t scale) {
  while (*text != '\0') {
    draw_char(x, y, *text, scale);
    x = static_cast<int16_t>(x + 6 * scale);
    ++text;
  }
}

static void draw_centered(int16_t y, const char *text, uint8_t scale) {
  if (text == nullptr || text[0] == '\0') {
    return;
  }
  const int16_t width = static_cast<int16_t>(strlen(text) * 6 * scale);
  int16_t x = static_cast<int16_t>((EPD_WIDTH - width) / 2);
  if (x < 0) {
    x = 0;
  }
  draw_text(x, y, text, scale);
}

static void board_power_on() {
  i2c_bus = I2cMasterBus::requestInstance(ESP32_I2C_SCL_PIN, ESP32_I2C_SDA_PIN, ESP32_I2C_DEV_NUM);
  assert(i2c_bus);
  ESP_ERROR_CHECK(esp_io_expander_new_i2c_tca9554(
      i2c_bus->Get_I2cBusHandle(), ESP_IO_EXPANDER_I2C_TCA9554_ADDRESS_000, &io_expander));
  ESP_ERROR_CHECK(esp_io_expander_set_dir(
      io_expander,
      IO_EXPANDER_PIN_NUM_0 | IO_EXPANDER_PIN_NUM_1 | IO_EXPANDER_PIN_NUM_3 | IO_EXPANDER_PIN_NUM_5,
      IO_EXPANDER_OUTPUT));
  ESP_ERROR_CHECK(esp_io_expander_set_level(
      io_expander,
      IO_EXPANDER_PIN_NUM_0 | IO_EXPANDER_PIN_NUM_1 | IO_EXPANDER_PIN_NUM_3 | IO_EXPANDER_PIN_NUM_5, 1));
}

void eink_status_begin(void) {
  board_power_on();
  PortDisplay_Init();
  EPD_Init();
  EPD_Clear();
  EPD_Display();
}

void eink_status_show(const char *title, const char *line1, const char *line2, const char *line3) {
  EPD_Clear();
  draw_centered(24, title != nullptr ? title : "", 2);
  EPD_DrawHLine(24, 52, EPD_WIDTH - 48, DRIVER_COLOR_BLACK);
  draw_centered(72, line1 != nullptr ? line1 : "", 1);
  draw_centered(96, line2 != nullptr ? line2 : "", 1);
  draw_centered(120, line3 != nullptr ? line3 : "", 1);
  EPD_Display();
}

bool eink_show_qr(const char *payload, const char *web_url) {
  if (payload == nullptr || payload[0] == '\0') {
    return false;
  }

  // Nayuki qrcodegen — correct encoder, buffers in BSS (not stack VLAs).
  constexpr int kMaxVersion = 10;
  constexpr int16_t kUrlBand = 16;
  constexpr int16_t kQrArea = EPD_HEIGHT - kUrlBand;
  constexpr int kQuietModules = 4;
  constexpr int kMinScale = 3;

  static uint8_t tempBuffer[qrcodegen_BUFFER_LEN_FOR_VERSION(kMaxVersion)];
  static uint8_t qrcode[qrcodegen_BUFFER_LEN_FOR_VERSION(kMaxVersion)];

  bool ok = false;
  // Prefer medium ECC; fall back to low if the string needs a smaller version
  // so modules stay chunky enough for phone cameras on a 200px panel.
  const enum qrcodegen_Ecc ecc_try[] = {qrcodegen_Ecc_MEDIUM, qrcodegen_Ecc_LOW};
  for (size_t i = 0; i < 2; ++i) {
    if (qrcodegen_encodeText(payload, tempBuffer, qrcode, ecc_try[i], 1, kMaxVersion,
                             qrcodegen_Mask_AUTO, true)) {
      ok = true;
      break;
    }
  }
  if (!ok) {
    Serial.printf("QR encode failed (%u chars)\n", (unsigned)strlen(payload));
    return false;
  }

  const int size = qrcodegen_getSize(qrcode);
  const int scale = static_cast<int>(kQrArea) / (size + 2 * kQuietModules);
  if (scale < kMinScale) {
    Serial.printf("QR too dense for panel (modules=%d). Shorten fields.\n", size);
    return false;
  }

  const int16_t side = static_cast<int16_t>(size * scale);
  const int16_t quiet_px = static_cast<int16_t>(kQuietModules * scale);
  const int16_t total = static_cast<int16_t>(side + 2 * quiet_px);
  const int16_t frame_x = static_cast<int16_t>((EPD_WIDTH - total) / 2);
  const int16_t frame_y = static_cast<int16_t>(kUrlBand + (kQrArea - total) / 2);
  const int16_t origin_x = static_cast<int16_t>(frame_x + quiet_px);
  const int16_t origin_y = static_cast<int16_t>(frame_y + quiet_px);

  EPD_Clear();
  draw_centered(4, web_url != nullptr ? web_url : "", 1);

  for (int y = 0; y < size; ++y) {
    for (int x = 0; x < size; ++x) {
      if (qrcodegen_getModule(qrcode, x, y)) {
        EPD_FillRect(origin_x + x * scale, origin_y + y * scale, scale, scale, DRIVER_COLOR_BLACK);
      }
    }
  }

  EPD_Display();

  Serial.printf("QR modules=%d scale=%d quiet=%d payload=%u\n", size, scale, quiet_px,
                (unsigned)strlen(payload));
  return true;
}
